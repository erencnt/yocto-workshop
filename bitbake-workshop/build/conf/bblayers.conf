## bitbake-workshop/meta-workshop/conf/layer.conf
```bitbake
BBPATH .= ":${LAYERDIR}"
BBFILES += "${LAYERDIR}/recipes-*/*/*.bb"

BBFILE_COLLECTIONS += "workshop"
BBFILE_PATTERN_workshop = "^${LAYERDIR}/"
BBFILE_PRIORITY_workshop = "5"
```
